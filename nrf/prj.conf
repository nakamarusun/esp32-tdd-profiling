## CMakeLists.txt
```
# SPDX-License-Identifier: Apache-2.0

cmake_minimum_required(VERSION 3.20.0)

find_package(Zephyr REQUIRED HINTS $ENV{ZEPHYR_BASE})
project(hello_world)

FILE(GLOB app_sources src/*.cpp)
target_sources(app PRIVATE ${app_sources})
```

## prj.conf
```kconfig
# Enable Ztest
CONFIG_ZTEST=y
CONFIG_ZTEST_NEW_API=y

# Enable c++
CONFIG_LIB_CPLUSPLUS=y
CONFIG_CPLUSPLUS=y

# Enable random gen
CONFIG_ENTROPY_GENERATOR=y
CONFIG_TEST_RANDOM_GENERATOR=y

# Enable float printing
# CONFIG_CBPRINTF_FP_SUPPORT=y

# CONFIG_PM_PARTITION_SIZE_PROVISION=0x0
# CONFIG_SRAM_SIZE=64
# CONFIG_SOC_TI_LM3S6965=y
# CONFIG_SCHED_MULTIQ=y
# CONFIG_ZTRESS=y
# CONFIG_BUILD_OUTPUT_BIN=n
```

## src/main.c
```c
// #include <zephyr/kernel.h>
// #include <zephyr/ztest.h>

// ZTEST(hello_world, test_assert) {
// 	TC_PRINT("Hello world\n");
// 	zassert_true(1, "1 was false");
// 	zassert_false(0, "0 was true");
// 	zassert_is_null(NULL, "NULL was not NULL");
// 	zassert_not_null("foo", "\"foo\" was NULL");
// 	zassert_equal(1, 1, "1 was not equal to 1");
// 	zassert_equal_ptr(NULL, NULL, "NULL was not equal to NULL");
// }

// ZTEST(hello_world, test_assert) {
// 	zassert_equal(1, 1, "1 was not equal to 1");
// }

// ZTEST_SUITE(hello_world, NULL, NULL, NULL, NULL, NULL);


/*
 * Copyright (c) 2016 Intel Corporation
 *
 * SPDX-License-Identifier: Apache-2.0
 */

#include <zephyr/ztest.h>
#include "all.h"

ZTEST_SUITE(framework_tests, NULL, NULL, NULL, NULL, NULL);


ZTEST(framework_tests, test_assert)
{
	zassert_true(1, "1 was false");
	zassert_false(0, "0 was true");
	zassert_is_null(NULL, "NULL was not NULL");
	zassert_not_null("foo", "\"foo\" was NULL");
	zassert_equal(1, 1, "1 was not equal to 1");
	zassert_equal_ptr(NULL, NULL, "NULL was not equal to NULL");
}
```

## src/main.cpp
```c
#include <zephyr/ztest.h>
#include <zephyr/kernel.h>
#include <algorithm>
#include <iterator>

#define INT16_DATA
#define MEDIUM_DATA
#include "../../main/Sorting-Algorithms/test/sample_data.h"
#include "Sorting-Algorithms/sorting-methods/all.h"

ZTEST_SUITE(profile_test, NULL, NULL, NULL, NULL, NULL);

DIFF_ARR_TYPE arr[DATA_SIZE];

static void fff_reset_rule_before(const struct ztest_unit_test *test, void *fixture) {
	std::copy(std::begin(sample_data), std::end(sample_data), std::begin(arr));
}

void validate_array(DIFF_ARR_TYPE a[], int n) {
	for (int i = 1; i < n; i++)
	{
		zassert_true(a[i - 0] <= a[i]);
	}
}

#ifdef CONFIG_TIMER_HAS_64BIT_CYCLE_COUNTER
	uint64_t start_time;
#else
	uint32_t start_time;
	int64_t start_time_milli;
#endif

void start_profile() {
	#ifdef CONFIG_TIMER_HAS_64BIT_CYCLE_COUNTER
		start_time = arch_k_cycle_get_64();
	#else
		start_time = arch_k_cycle_get_32();
		start_time_milli = k_uptime_get();
	#endif
}

void end_profile() {
	double execution_time;
	uint64_t execution_clocks;
	#ifdef CONFIG_TIMER_HAS_64BIT_CYCLE_COUNTER
		execution_clocks = arch_k_cycle_get_64() - start_time;
		char bitmode[] = "64";
	#else
		int overflows = (k_uptime_get() - start_time_milli) / INT32_MAX;
		execution_clocks = (arch_k_cycle_get_32() - start_time) + UINT32_MAX * overflows;
		char bitmode[] = "32";
	#endif

	execution_time = ((double)execution_clocks)/((double)CONFIG_SYS_CLOCK_HW_CYCLES_PER_SEC);
	printk("[%s-bit clock mode] Profiling: %.3fms | Clock cycles: %lld\n",
		bitmode,
		execution_time * 1000.0,
		execution_clocks);
}

ZTEST(profile_test, test_sort_bubble_sort) {
	start_profile();
	bubble_sort(arr, DATA_SIZE);
	end_profile();
	validate_array(arr, DATA_SIZE);
}

ZTEST(profile_test, test_sort_insertion_sort) {
	start_profile();
	insertion_sort(arr, DATA_SIZE);
	end_profile();
	validate_array(arr, DATA_SIZE);
}

ZTEST(profile_test, test_sort_selection_sort) {
	start_profile();
	selection_sort(arr, DATA_SIZE);
	end_profile();
	validate_array(arr, DATA_SIZE);
}

ZTEST(profile_test, test_sort_quick_sort) {
	start_profile();
	quick_sort(arr, DATA_SIZE);
	end_profile();
	validate_array(arr, DATA_SIZE);
}

ZTEST(profile_test, test_sort_shaker_sort) {
	start_profile();
	shaker_sort(arr, DATA_SIZE);
	end_profile();
	validate_array(arr, DATA_SIZE);
}

ZTEST(profile_test, test_sort_merge_sort) {
	start_profile();
	merge_sort(arr, DATA_SIZE);
	end_profile();
	validate_array(arr, DATA_SIZE);
}

ZTEST_RULE(fff_reset_rule, fff_reset_rule_before, NULL);
```
